## drivers/sensor/Kconfig
```kconfig
# Copyright (c) 2021 Nordic Semiconductor ASA
# SPDX-License-Identifier: Apache-2.0

if SENSOR
rsource "example_sensor/Kconfig"
rsource "lidar_lite_v4/Kconfig"
endif # SENSOR
```

## drivers/sensor/lidar_lite_v4/Kconfig
```kconfig
menuconfig LIDAR_LITE_V4
	bool "Enable Lidar Lite V4 support"
	default y
	select I2C
	help
	  Enable driver for Lidar Lite V4.
```

## dts/bindings/sensor/garmin,lidar-lite-v4.yaml
```yaml
# Copyright (c) 2025 Alex
# SPDX-License-Identifier: Apache-2.0

description: Garmin LIDAR-Lite v4 laser rangefinder

compatible: "garmin,lidar-lite-v4"

include: [sensor-device.yaml, i2c-device.yaml]

properties:
  label:
    description: Human readable string describing the device
    type: string
```
